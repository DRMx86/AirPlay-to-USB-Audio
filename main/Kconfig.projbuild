## main/Kconfig.projbuild
```kconfig
menu "Web Radio to USB DAC Audio"
    # Board / pin configuration lives in components/boards/Kconfig.projbuild.

    menu "Wi-Fi"

        config WIFI_AP_SSID
            string "Setup access point name"
            default "WebRadio"
            help
                Name of the Wi-Fi network the radio opens when it has no saved
                network (or cannot reach it). Join it with a phone or laptop;
                the setup page opens by itself, or go to http://192.168.4.1/.

        config WIFI_AP_PASSWORD
            string "Setup access point password"
            default ""
            help
                Leave empty for an open setup network, or use 8 to 63
                characters for WPA2. The network is only up while setting up.

        config WIFI_MAX_RETRY
            int "Connection attempts before opening the setup portal"
            default 5
            range 1 30
            help
                How often the saved network is tried at boot before the setup
                access point opens. Once connected, a dropped link is retried
                forever without opening the portal.

    endmenu

    menu "Web Radio"

        config RADIO_BUFFER_KB
            int "Stream buffer size (KB)"
            default 128
            range 16 1024
            help
                Compressed audio kept between the network and the decoder
                (allocated in PSRAM when available). It rides out Wi-Fi
                dropouts: 128 KB is about 8 seconds of a 128 kbit/s stream.

        config RADIO_PREBUFFER_KB
            int "Buffer filled before playback starts (KB)"
            default 32
            range 4 512
            help
                Playback starts once this much audio is buffered. Must be
                smaller than the stream buffer size. Larger values start more
                slowly but are less likely to stutter.

        config RADIO_HTTP_TIMEOUT_MS
            int "Network timeout (ms)"
            default 10000
            range 2000 60000
            help
                Connect and read timeout for the stream. After three
                consecutive read timeouts the player reconnects.

        config RADIO_NEXT_BUTTON_GPIO
            int "Next-station button GPIO (-1 = none)"
            default -1
            range -1 48
            help
                Optional push button wired between this GPIO and GND (the
                internal pull-up is enabled). Each press switches to the next
                station in main/radio/stations.c.

    endmenu

    menu "USB DAC Output"

        config OUTPUT_SAMPLE_RATE_HZ
            int "USB DAC sample rate"
            default 48000
            help
                Sample rate sent to the USB DAC dongle (stereo, 16-bit
                internally; expanded to 24/32-bit if the dongle needs it).
                Works with UAC 1.0 and UAC 2.0 dongles. The dongle must
                support the rate; 44100 and 48000 work on nearly all.
                Streams at any other rate are resampled to this rate. Use
                48000 (default): the resampler is not built for a 44100 output,
                so a 44100 setting only plays 44.1 kHz streams correctly.

        config USB_AUDIO_BUFFER_MS
            int "USB FIFO size (ms)"
            default 60
            range 20 500
            help
                Size of the FIFO between the decoder and the USB isochronous
                transfers to the DAC. Larger values tolerate more jitter but
                add latency.

        config USB_AUDIO_PRIME_MS
            int "USB prefill before streaming starts (ms)"
            default 20
            range 5 250
            help
                Amount of audio that must be buffered before data is sent to
                the USB DAC (after start-up or after an underrun). Must be
                smaller than the buffer size. This is roughly the steady-state
                latency added by the buffer.

        config USB_AUDIO_INITIAL_VOLUME_PERCENT
            int "Initial volume (%)"
            default 10
            range 0 100
            help
                Volume used at every boot and whenever a USB DAC is plugged in,
                before any audio is sent. Keep it low: a speaker that was left
                loud (or a DAC that defaults to maximum) must never blast.
                0 starts muted. The volume can then be changed from the web
                page, or with the speaker's own controls if it has them.
                The percentage covers the top 60 dB of the DAC's volume range.

        config USB_HOST_VBUS_EN_GPIO
            int "USB host VBUS enable GPIO (-1 = none)"
            default -1
            range -1 48
            help
                GPIO driven HIGH at start-up to switch 5 V onto the USB host
                port's VBUS (e.g. a load switch). Leave at -1 if the board
                already supplies 5 V to the native USB port VBUS. The DAC
                dongle needs 5 V on VBUS to power up.

    endmenu

    config RESAMPLER_TAPS
        int "Resampler filter taps (quality)"
        range 4 64
        default 28 if IDF_TARGET_ESP32S3
        default 12 if IDF_TARGET_ESP32
        default 16
        help
            Number of taps for the sinc resampler filters (used when the
            stream rate differs from the USB DAC rate, e.g. 44.1 -> 48 kHz).
            Must be a multiple of 4.
            ESP32-S3 (hardware FPU): 28 recommended.

endmenu
```

## sdkconfig.defaults
```kconfig
# Default values

# PSRAM support
CONFIG_SPIRAM=y
CONFIG_SPIRAM_SPEED_80M=y
CONFIG_FREERTOS_TASK_CREATE_ALLOW_EXT_MEM=y

# FLASH mode
CONFIG_ESPTOOLPY_FLASHMODE_QIO=y
CONFIG_ESPTOOLPY_FLASHMODE="qio"

# CPU frequency
CONFIG_ESP_DEFAULT_CPU_FREQ_MHZ_240=y
CONFIG_ESP_DEFAULT_CPU_FREQ_MHZ=240

# Logging
CONFIG_LOG_DEFAULT_LEVEL_INFO=y
CONFIG_LOG_DEFAULT_LEVEL=3
CONFIG_LOG_COLORS=y

# Partition table
CONFIG_PARTITION_TABLE_CUSTOM=y
CONFIG_PARTITION_TABLE_CUSTOM_FILENAME="components/boards/partitions.csv"

# Compiler optimization
CONFIG_COMPILER_OPTIMIZATION_PERF=y

# Memory tweaks: push allocations > 1024 bytes to SPIRAM
CONFIG_SPIRAM_MALLOC_ALWAYSINTERNAL=1024
```
